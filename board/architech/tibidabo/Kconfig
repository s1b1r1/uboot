## board/architech/tibidabo/Kconfig
```kconfig
if TARGET_MX6TIBIDABO

config SYS_BOARD
	default "mx6tibidabo"

config SYS_VENDOR
	default "architech"

config SYS_CONFIG_NAME
	default "mx6tibidabo"

endif
```
